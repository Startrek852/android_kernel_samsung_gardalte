## arch/arm/mach-exynos/Kconfig
```kconfig
# arch/arm/mach-exynos/Kconfig
#
# Copyright (c) 2010-2011 Samsung Electronics Co., Ltd.
#		http://www.samsung.com/
#
# Licensed under GPLv2

# Configuration options for the EXYNOS4

if ARCH_EXYNOS

menu "SAMSUNG EXYNOS SoCs Support"

choice
	prompt "EXYNOS System Type"
	default ARCH_EXYNOS5

config ARCH_EXYNOS4
	bool "SAMSUNG EXYNOS4"
	select HAVE_SMP
	select MIGHT_HAVE_CACHE_L2X0
	select ARM_ERRATA_761320 if SMP
	select ARM_ERRATA_764369
	help
	  Samsung EXYNOS4 SoCs based systems

config ARCH_EXYNOS5
	bool "SAMSUNG EXYNOS5"
	select HAVE_SMP
	select ARCH_NEEDS_CPU_IDLE_COUPLED
	select HAVE_EXYNOS5_HSI2C if I2C
	select ARM_ERRATA_773022
	select ARM_ERRATA_774769
	help
	  Samsung EXYNOS5 (Cortex-A15) SoC based systems

endchoice

comment "EXYNOS SoCs"

config CPU_EXYNOS4210
	bool "SAMSUNG EXYNOS4210"
	default y
	depends on ARCH_EXYNOS4
	select SAMSUNG_DMADEV
	select ARM_CPU_SUSPEND if PM
	select S5P_PM if PM
	select S5P_SLEEP if PM
	select PM_GENERIC_DOMAINS
	help
	  Enable EXYNOS4210 CPU support

config SOC_EXYNOS4212
	bool "SAMSUNG EXYNOS4212"
	default y
	depends on ARCH_EXYNOS4
	select SAMSUNG_DMADEV
	select S5P_PM if PM
	select S5P_SLEEP if PM
	select ARCH_HAS_OPP
	select PM_OPP if PM
	select PM_GENERIC_DOMAINS if PM_RUNTIME
	help
	  Enable EXYNOS4212 SoC support

config SOC_EXYNOS4412
	bool "SAMSUNG EXYNOS4412"
	default y
	depends on ARCH_EXYNOS4
	select SAMSUNG_DMADEV
	select ARCH_HAS_OPP
	select PM_OPP if PM
	select PM_GENERIC_DOMAINS if PM_RUNTIME
	help
	  Enable EXYNOS4412 SoC support

config SOC_EXYNOS4270
	bool "SAMSUNG EXYNOS4270"
	default y
	depends on ARCH_EXYNOS4
	select SAMSUNG_DMADEV
	select ARCH_HAS_OPP
	select S5P_PM if PM
	select S5P_SLEEP if PM
	select PM_GENERIC_DOMAINS if PM_RUNTIME
	help
	  Enable EXYNOS4270 SoC support

config SOC_EXYNOS3470
	bool "SAMSUNG EXYNOS3470"
	default y
	depends on ARCH_EXYNOS4
	select SAMSUNG_DMADEV
	select ARCH_HAS_OPP
	select S5P_PM if PM
	select S5P_SLEEP if PM
	select PM_GENERIC_DOMAINS if PM_RUNTIME
	help
	  Enable EXYNOS3470 SoC support

config SOC_EXYNOS5250
	bool "SAMSUNG EXYNOS5250"
	default y
	depends on ARCH_EXYNOS5
	select SAMSUNG_DMADEV
	select S5P_PM if PM
	select S5P_SLEEP if PM
	select PM_GENERIC_DOMAINS if PM_RUNTIME
	select ARM_ERRATA_766421
	help
	  Enable EXYNOS5250 SoC support

config EXYNOS_CONTENT_PATH_PROTECTION
	bool "Exynos Content Path Protection"
	depends on (ARM_TRUSTZONE)
	default n
	help
	  Enable content path protection of EXYNOS.

config EXYNOS4_MCT
	bool
	default y
	select HAVE_SCHED_CLOCK
	help
	  Use MCT (Multi Core Timer) as kernel timers

config EXYNOS_DEV_DMA
	bool
	help
	  Compile in amba device definitions for DMA controller

config EXYNOS4_DEV_AHCI
	bool
	help
	  Compile in platform device definitions for AHCI

config EXYNOS4_SETUP_FIMD0
	bool
	help
	  Common setup code for FIMD0.

config EXYNOS_SETUP_FIMD1
	bool
	help
	  Common setup code for FIMD1.

config EXYNOS_SETUP_ADC
	bool
	help
	  Common setup code for ADC.

config EXYNOS_SETUP_DP
	bool
	help
	  Common setup code for DP.

config EXYNOS_DEV_SYSMMU
	bool
	help
	  Common setup code for SYSTEM MMU in EXYNOS

config EXYNOS_DEV_DWMCI
	bool
	help
	  Compile in platform device definitions for DWMCI

config EXYNOS_DEV_MODEM_SS222
	bool "SAMSUNG SS222 MODEM IP"
	default n
	depends on (SOC_EXYNOS4270 || SOC_EXYNOS3470)
	select EXYNOS_DEV_SHARED_MEMORY
	help
	  Enable SS222 modem IP block

config EXYNOS_DEV_SHARED_MEMORY
	bool
	default n
	depends on (SOC_EXYNOS4270 || SOC_EXYNOS3470)
	select EXYNOS4_DEV_MCU_IPC
	help
	  Compile in platform device definitions for "Shared Memory" between AP and CP

config EXYNOS4_DEV_MCU_IPC
	bool
	select MCU_IPC
	help
	  Compile in platform device definitions for MCU_IPC

config EXYNOS4_DEV_FIMC_LITE
	bool
	depends on VIDEO_EXYNOS_FIMC_LITE
	default y
	help
	  Compile in platform device definitions for FIMC_LITE

config EXYNOS_DEV_FIMC_IS
	bool
	depends on (VIDEO_EXYNOS4_FIMC_IS || VIDEO_EXYNOS_FIMC_IS)
	default y
	help
	  Compile in platform device definition for FIMC-IS

config EXYNOS5_DEV_FIMC_IS
	bool
	depends on (VIDEO_EXYNOS5_FIMC_IS)
	default y
	help
	  Compile in platform device definition for FIMC-IS

config EXYNOS_DEV_ROTATOR
	bool
	help
	  Compile in platform device definitions for EXYNOS ROTATOR
	  NOTE: EXYNOS4 is not supported yet, it will be implemented.

config EXYNOS4_DEV_USB_OHCI
	bool
	help
	  Compile in platform device definition for USB OHCI

config EXYNOS5_DEV_USB3_DRD
	bool
	help
	  Compile in platform device definition for EXYNOS5 SuperSpeed USB 3.0
	  DRD controller.

config EXYNOS_DEV_USB_SWITCH
	bool
	help
	  Compile in platform device definitions for USB-SWITCH

config EXYNOS5_DEV_HSI2C0
	bool
	help
	  Compile in platform device definitions for HS-I2C channel 0

config EXYNOS5_DEV_HSI2C1
	bool
	help
	  Compile in platform device definitions for HS-I2C channel 1

config EXYNOS5_DEV_HSI2C2
	bool
	help
	  Compile in platform device definitions for HS-I2C channel 2

config EXYNOS5_DEV_HSI2C3
	bool
	help
	  Compile in platform device definitions for HS-I2C channel 3

config EXYNOS4_SETUP_I2C1
	bool
	help
	  Common setup code for i2c bus 1.

config EXYNOS4_SETUP_I2C2
	bool
	help
	  Common setup code for i2c bus 2.

config EXYNOS4_SETUP_I2C3
	bool
	help
	  Common setup code for i2c bus 3.

config EXYNOS4_SETUP_I2C4
	bool
	help
	  Common setup code for i2c bus 4.

config EXYNOS4_SETUP_I2C5
	bool
	help
	  Common setup code for i2c bus 5.

config EXYNOS4_SETUP_I2C6
	bool
	help
	  Common setup code for i2c bus 6.

config EXYNOS4_SETUP_I2C7
	bool
	help
	  Common setup code for i2c bus 7.

config EXYNOS5_SETUP_HSI2C0
	bool
	help
	  Common setup code for hs-i2c bus 0.

config EXYNOS5_SETUP_HSI2C1
	bool
	help
	  Common setup code for hs-i2c bus 1.

config EXYNOS5_SETUP_HSI2C2
	bool
	help
	  Common setup code for hs-i2c bus 2.

config EXYNOS5_SETUP_HSI2C3
	bool
	help
	  Common setup code for hs-i2c bus 3.

config EXYNOS4_SETUP_KEYPAD
	bool
	help
	  Common setup code for keypad.

config EXYNOS4_SETUP_MFC
	bool
	help
	  Common setup code for MFC.

config EXYNOS4_SETUP_SDHCI
	bool
	select EXYNOS4_SETUP_SDHCI_GPIO
	help
	  Internal helper functions for EXYNOS4 based SDHCI systems.

config EXYNOS4_SETUP_SDHCI_GPIO
	bool
	help
	  Common setup code for SDHCI gpio.

config EXYNOS4_SETUP_FIMC
	bool
	help
	  Common setup code for the camera interfaces.

config EXYNOS4_SETUP_USB_PHY
	bool
	help
	  Common setup code for USB PHY controller

config EXYNOS_SETUP_FIMC_IS
	bool
	depends on (VIDEO_EXYNOS4_FIMC_IS || VIDEO_EXYNOS_FIMC_IS)
	default y
	help
	  Common setup code for the FIMC-IS-MC

config EXYNOS4_BTS
	bool "Bus traffic shaper support"
	default y
	depends on (SOC_EXYNOS4270 || SOC_EXYNOS3470)
	help
	  Enable BTS (Bus traffic shaper) support

config EXYNOS5_SETUP_FIMC_IS
	bool
	depends on (VIDEO_EXYNOS5_FIMC_IS)
	default y
	help
	  Common setup code for the FIMC-IS-MC

config EXYNOS_SETUP_SPI
	bool
	help
	  Common setup code for SPI GPIO configurations.

config EXYNOS_FIQ_DEBUGGER
	bool "Exynos FIQ debugger support"
	depends on FIQ_DEBUGGER
	default y
	help
	  Exynos platform support for the FIQ debugger

config EXYNOS5_CORESIGHT
	bool "EXYNOS5 embedded trace support"
	depends on ARCH_EXYNOS5
	select OC_ETM
	help
	  Enable embedded trace support

config EXYNOS_PERSISTENT_CLOCK
	bool
	depends on !RTC_DRV_S3C
	default n
	help
	  Persistent-clock-only driver for EXYNOS RTC.

config EXYNOS_DEV_TMU
	bool
	help
	  Compile in platform device definitions for TMU

config EXYNOS_TMU
	bool "Use thermal management"
	depends on CPU_FREQ
	help
	  Common setup code for TMU

config EXYNOS5_DEV_BTS
	bool
	depends on ARCH_EXYNOS5
	select S5P_DEV_BTS
	help
	  Compile in platform device definitions for BTS devices

# machine support

if ARCH_EXYNOS4

comment "EXYNOS4210 Boards"

config MACH_SMDKC210
	bool "SMDKC210"
	select MACH_SMDKV310
	help
	  Machine support for Samsung SMDKC210

config MACH_SMDKV310
	bool "SMDKV310"
	select CPU_EXYNOS4210
	select S5P_DEV_FIMD0
	select S3C_DEV_RTC
	select S3C_DEV_WDT
	select S3C_DEV_I2C1
	select S5P_DEV_FIMC0
	select S5P_DEV_FIMC1
	select S5P_DEV_FIMC2
	select S5P_DEV_FIMC3
	select S5P_DEV_G2D
	select S5P_DEV_I2C_HDMIPHY
	select S5P_DEV_JPEG
	select S5P_DEV_MFC
	select S5P_DEV_TV
	select S5P_DEV_USB_EHCI
	select S3C_DEV_HSMMC
	select S3C_DEV_HSMMC1
	select S3C_DEV_HSMMC2
	select S3C_DEV_HSMMC3
	select SAMSUNG_DEV_BACKLIGHT
	select EXYNOS4_DEV_AHCI
	select SAMSUNG_DEV_KEYPAD
	select SAMSUNG_DEV_PWM
	select EXYNOS_DEV_DMA
	select EXYNOS4_DEV_USB_OHCI
	select EXYNOS4_SETUP_FIMD0
	select EXYNOS4_SETUP_I2C1
	select EXYNOS4_SETUP_KEYPAD
	select EXYNOS4_SETUP_SDHCI
	select EXYNOS4_SETUP_USB_PHY
	help
	  Machine support for Samsung SMDKV310

config MACH_ARMLEX4210
	bool "ARMLEX4210"
	select CPU_EXYNOS4210
	select S3C_DEV_RTC
	select S3C_DEV_WDT
	select S3C_DEV_HSMMC
	select S3C_DEV_HSMMC2
	select S3C_DEV_HSMMC3
	select EXYNOS_DEV_DMA
	select EXYNOS4_DEV_AHCI
	select EXYNOS4_SETUP_SDHCI
	help
	  Machine support for Samsung ARMLEX4210 based on EXYNOS4210

config MACH_UNIVERSAL_C210
	bool "Mobile UNIVERSAL_C210 Board"
	select CPU_EXYNOS4210
	select S5P_HRT
	select CLKSRC_MMIO
	select HAVE_SCHED_CLOCK
	select S5P_GPIO_INT
	select S5P_DEV_FIMC0
	select S5P_DEV_FIMC1
	select S5P_DEV_FIMC2
	select S5P_DEV_FIMC3
	select S5P_DEV_G2D
	select S5P_DEV_CSIS0
	select S5P_DEV_JPEG
	select S5P_DEV_FIMD0
	select S3C_DEV_HSMMC
	select S3C_DEV_HSMMC2
	select S3C_DEV_HSMMC3
	select S3C_DEV_I2C1
	select S3C_DEV_I2C3
	select S3C_DEV_I2C5
	select S5P_DEV_I2C_HDMIPHY
	select S5P_DEV_MFC
	select S5P_DEV_ONENAND
	select S5P_DEV_TV
	select EXYNOS_DEV_DMA
	select EXYNOS4_SETUP_FIMD0
	select EXYNOS4_SETUP_I2C1
	select EXYNOS4_SETUP_I2C3
	select EXYNOS4_SETUP_I2C5
	select EXYNOS4_SETUP_SDHCI
	select EXYNOS4_SETUP_FIMC
	select S5P_SETUP_MIPIPHY
	help
	  Machine support for Samsung Mobile Universal S5PC210 Reference
	  Board.

config MACH_NURI
	bool "Mobile NURI Board"
	select CPU_EXYNOS4210
	select S5P_GPIO_INT
	select S3C_DEV_WDT
	select S3C_DEV_RTC
	select S5P_DEV_FIMD0
	select S3C_DEV_HSMMC
	select S3C_DEV_HSMMC2
	select S3C_DEV_HSMMC3
	select S3C_DEV_I2C1
	select S3C_DEV_I2C3
	select S3C_DEV_I2C5
	select S3C_DEV_I2C6
	select S5P_DEV_CSIS0
	select S5P_DEV_JPEG
	select S5P_DEV_FIMC0
	select S5P_DEV_FIMC1
	select S5P_DEV_FIMC2
	select S5P_DEV_FIMC3
	select S5P_DEV_G2D
	select S5P_DEV_MFC
	select S5P_DEV_USB_EHCI
	select S5P_SETUP_MIPIPHY
	select EXYNOS_DEV_DMA
	select EXYNOS4_SETUP_FIMC
	select EXYNOS4_SETUP_FIMD0
	select EXYNOS4_SETUP_I2C1
	select EXYNOS4_SETUP_I2C3
	select EXYNOS4_SETUP_I2C5
	select EXYNOS4_SETUP_I2C6
	select EXYNOS4_SETUP_SDHCI
	select EXYNOS4_SETUP_USB_PHY
	select S5P_SETUP_MIPIPHY
	select SAMSUNG_DEV_PWM
	select SAMSUNG_DEV_ADC
	help
	  Machine support for Samsung Mobile NURI Board.

config MACH_ORIGEN
	bool "ORIGEN"
	select CPU_EXYNOS4210
	select S3C_DEV_RTC
	select S3C_DEV_WDT
	select S3C_DEV_HSMMC
	select S3C_DEV_HSMMC2
	select S5P_DEV_FIMC0
	select S5P_DEV_FIMC1
	select S5P_DEV_FIMC2
	select S5P_DEV_FIMC3
	select S5P_DEV_FIMD0
	select S5P_DEV_G2D
	select S5P_DEV_I2C_HDMIPHY
	select S5P_DEV_JPEG
	select S5P_DEV_MFC
	select S5P_DEV_TV
	select S5P_DEV_USB_EHCI
	select SAMSUNG_DEV_BACKLIGHT
	select SAMSUNG_DEV_PWM
	select EXYNOS_DEV_DMA
	select EXYNOS4_DEV_USB_OHCI
	select EXYNOS4_SETUP_FIMD0
	select EXYNOS4_SETUP_SDHCI
	select EXYNOS4_SETUP_USB_PHY
	help
	  Machine support for ORIGEN based on Samsung EXYNOS4210

comment "EXYNOS4212 Boards"

config MACH_SMDK4212
	bool "SMDK4212"
	select SOC_BUS
	select SOC_EXYNOS4212
	select S3C_DEV_HSMMC2
	select S3C_DEV_HSMMC3
	select S3C_DEV_HWMON if S3C_ADC
	select S3C_DEV_I2C1
	select S3C_DEV_I2C3
	select S3C_DEV_I2C4
	select S3C_DEV_I2C5
	select S3C_DEV_I2C7
	select S3C_DEV_RTC
	select S3C_DEV_WDT
	select S3C_DEV_FIMD0
	select S5P_DEV_FIMC0
	select S5P_DEV_FIMC1
	select S5P_DEV_FIMC2
	select S5P_DEV_FIMC3
	select S5P_DEV_CSIS0
	select S5P_DEV_CSIS1
	select S5P_DEV_FLITE0
	select S5P_DEV_FLITE1
	select S5P_GPIO_INT
	select S5P_DEV_FIMD0
	select S5P_DEV_MFC
	select S5P_GPIO_INT
	select SAMSUNG_DEV_ADC
	select SAMSUNG_DEV_BACKLIGHT
	select SAMSUNG_DEV_KEYPAD
	select SAMSUNG_DEV_PWM
	select EXYNOS_DEV_DMA
	select EXYNOS_DEV_DWMCI
	select EXYNOS_DEV_SYSMMU
	select EXYNOS4_SETUP_I2C1
	select EXYNOS4_SETUP_I2C3
	select EXYNOS4_SETUP_I2C4
	select EXYNOS4_SETUP_I2C5
	select EXYNOS4_SETUP_I2C7
	select EXYNOS4_SETUP_KEYPAD
	select EXYNOS4_SETUP_SDHCI
	select EXYNOS4_SETUP_FIMD0
	select EXYNOS4_SETUP_MFC
	help
	  Machine support for Samsung SMDK4212

comment "EXYNOS4412 Boards"

config MACH_SMDK4412
	bool "SMDK4412"
	select SOC_EXYNOS4412
	select MACH_SMDK4212
	select S3C_DEV_USB_HSOTG
	select S5P_DEV_USB_EHCI
	select EXYNOS4_DEV_USB_OHCI
	select EXYNOS4_SETUP_USB_PHY
	help
	  Machine support for Samsung SMDK4412

menu "EXYNOS3 Boards Revision Type"

comment "SMDK Boards"

config MACH_SMDK4270
	bool "SMDK4270 (Rev0.0)"
	select SOC_EXYNOS4270
	select S3C_DEV_I2C1
	select S3C_DEV_I2C2
	select S3C_DEV_I2C3
	select S3C_DEV_I2C4
	select S3C_DEV_I2C5
	select S3C_DEV_I2C7
	select S3C_DEV_WDT
	select S3C_DEV_RTC
	select S3C_DEV_USB_HSOTG
	select S5P_DEV_USB_EHCI
	select S5P_GPIO_INT
	select S5P_DEV_FIMD0
	select S5P_DEV_MFC
	select EXYNOS_DEV_DMA
	select EXYNOS_DEV_SYSMMU
	select EXYNOS_DEV_DWMCI
	select EXYNOS_SETUP_ADC
	select EXYNOS4_DEV_USB_OHCI
	select EXYNOS4_SETUP_I2C1
	select EXYNOS4_SETUP_I2C2
	select EXYNOS4_SETUP_I2C3
	select EXYNOS4_SETUP_I2C4
	select EXYNOS4_SETUP_I2C5
	select EXYNOS4_SETUP_I2C7
	select EXYNOS4_SETUP_USB_PHY
	select EXYNOS4_SETUP_FIMD0
	select EXYNOS4_SETUP_MFC
	select S5P_DEV_FIMC0
	select S5P_DEV_FIMC1
	select S5P_DEV_FIMC2
	select S5P_DEV_FIMC3
	select S5P_DEV_CSIS0
	select S5P_DEV_CSIS1
	select S5P_DEV_TV
	select SAMSUNG_DEV_ADC
	select S5P_DEV_FIMG2D
	help
	  Machine support for Samsung SMDK4270

config MACH_SMDK3470
	bool "SMDK3470 (Rev1.0)"
	select SOC_EXYNOS3470
	select S3C_DEV_I2C1
	select S3C_DEV_I2C2
	select S3C_DEV_I2C3
	select S3C_DEV_I2C4
	select S3C_DEV_I2C5
	select S3C_DEV_I2C7
	select EXYNOS_DEV_DWMCI
	select EXYNOS_SETUP_ADC
	select S3C_DEV_USB_HSOTG
	select S3C_DEV_WDT
	select S5P_DEV_USB_EHCI
	select S5P_DEV_CSIS0
	select S5P_DEV_CSIS1
	select S5P_DEV_FIMC0
	select S5P_DEV_FIMC1
	select S5P_DEV_FIMC2
	select S5P_DEV_FIMC3
	select S5P_DEV_FIMD0
	select S5P_DEV_MFC
	select S5P_DEV_TV
	select S5P_DEV_FIMG2D
	select S5P_GPIO_INT
	select SAMSUNG_DEV_ADC
	select EXYNOS_DEV_DMA
	select EXYNOS_DEV_SYSMMU
	select EXYNOS4_DEV_USB_OHCI
	select EXYNOS4_DEV_JPEG
	select EXYNOS4_SETUP_JPEG
	select EXYNOS4_SETUP_USB_PHY
	select EXYNOS4_SETUP_FIMD0
	select EXYNOS4_SETUP_I2C1
	select EXYNOS4_SETUP_I2C2
	select EXYNOS4_SETUP_I2C3
	select EXYNOS4_SETUP_I2C4
	select EXYNOS4_SETUP_I2C5
	select EXYNOS4_SETUP_I2C7
	select EXYNOS4_SETUP_MFC
	help
	  Machine support for Samsung SMDK3470

comment "universal Boards"

config MACH_UNIVERSAL222AP
	bool "UNIVERSAL222AP"
	select SOC_EXYNOS3470
	select S3C_DEV_I2C1
	select S3C_DEV_I2C2
	select S3C_DEV_I2C3
	select S3C_DEV_I2C4
	select S3C_DEV_I2C5
	select S3C_DEV_I2C6
	select S3C_DEV_I2C7
	select S3C_DEV_WDT
	select S3C_DEV_RTC
	select S3C_DEV_USB_HSOTG
	select S5P_DEV_USB_EHCI
	select S5P_GPIO_INT
	select S5P_DEV_FIMD0
	select S5P_DEV_MFC
	select EXYNOS_DEV_DMA
	select EXYNOS_DEV_SYSMMU
	select EXYNOS_DEV_DWMCI
	select EXYNOS_SETUP_ADC
	select EXYNOS4_DEV_USB_OHCI
	select EXYNOS4_DEV_JPEG
	select EXYNOS4_SETUP_I2C1
	select EXYNOS4_SETUP_I2C2
	select EXYNOS4_SETUP_I2C3
	select EXYNOS4_SETUP_I2C4
	select EXYNOS4_SETUP_I2C5
	select EXYNOS4_SETUP_I2C6
	select EXYNOS4_SETUP_I2C7
	select EXYNOS4_SETUP_USB_PHY
	select EXYNOS4_SETUP_FIMD0
	select EXYNOS4_SETUP_MFC
	select EXYNOS4_SETUP_JPEG
	select S5P_DEV_FIMC0
	select S5P_DEV_FIMC1
	select S5P_DEV_FIMC2
	select S5P_DEV_FIMC3
	select S5P_DEV_CSIS0
	select S5P_DEV_CSIS1
	select S5P_DEV_FIMG2D
	select S5P_DEV_TV
	select S3C64XX_DEV_SPI0
	select S3C64XX_DEV_SPI1
	select S3C64XX_DEV_SPI2
	select EXYNOS_SETUP_SPI
	select SAMSUNG_DEV_ADC
	select EXYNOS_SOUND_PLATFORM_DATA
	select EXYNOS4_BTS
	help
	  Machine support for UNIVERASL222AP board

config EXYNOS_SOUND_PLATFORM_DATA
        bool "Sound platform data"

config MACH_GARDA
	bool "GARDA"
	select SOC_EXYNOS3470
	select S3C_DEV_I2C1
	select S3C_DEV_I2C3
	select S3C_DEV_I2C4
	select S3C_DEV_I2C5
	select S3C_DEV_I2C6
	select S3C_DEV_I2C7
	select S3C_DEV_WDT
	select S3C_DEV_RTC
	select S3C_DEV_USB_HSOTG
	select S5P_DEV_USB_EHCI
	select S5P_GPIO_INT
	select S5P_DEV_FIMD0
	select S5P_DEV_MFC
	select EXYNOS_DEV_DMA
	select EXYNOS_DEV_SYSMMU
	select EXYNOS_DEV_DWMCI
	select EXYNOS_SETUP_ADC
	select EXYNOS4_DEV_USB_OHCI
	select EXYNOS4_DEV_JPEG
	select EXYNOS4_SETUP_I2C1
	select EXYNOS4_SETUP_I2C3
	select EXYNOS4_SETUP_I2C4
	select EXYNOS4_SETUP_I2C5
	select EXYNOS4_SETUP_I2C6
	select EXYNOS4_SETUP_I2C7
	select EXYNOS4_SETUP_USB_PHY
	select EXYNOS4_SETUP_FIMD0
	select EXYNOS4_SETUP_MFC
	select EXYNOS4_SETUP_JPEG
	select S5P_DEV_FIMC0
	select S5P_DEV_FIMC1
	select S5P_DEV_FIMC2
	select S5P_DEV_FIMC3
	select S5P_DEV_CSIS0
	select S5P_DEV_CSIS1
	select S5P_DEV_FIMG2D
	select S3C64XX_DEV_SPI0
	select S3C64XX_DEV_SPI1
	select S3C64XX_DEV_SPI2
	select EXYNOS_SETUP_SPI
	select SAMSUNG_DEV_PWM
	select SAMSUNG_DEV_ADC
	select EXYNOS_PERSISTENT_CLOCK
	select EXYNOS_SOUND_PLATFORM_DATA
	help
	  Machine support for UNIVERASL222AP board

config MACH_WICHITA
	bool "WICHITA"
	select SOC_EXYNOS3470
	select S3C_DEV_I2C1
	select S3C_DEV_I2C3
	select S3C_DEV_I2C4
	select S3C_DEV_I2C5
	select S3C_DEV_I2C6
	select S3C_DEV_I2C7
	select S3C_DEV_WDT
	select S3C_DEV_RTC
	select S3C_DEV_USB_HSOTG
	select S5P_DEV_USB_EHCI
	select S5P_GPIO_INT
	select S5P_DEV_FIMD0
	select S5P_DEV_MFC
	select EXYNOS_DEV_DMA
	select EXYNOS_DEV_SYSMMU
	select EXYNOS_DEV_DWMCI
	select EXYNOS_SETUP_ADC
	select EXYNOS4_DEV_USB_OHCI
	select EXYNOS4_DEV_JPEG
	select EXYNOS4_SETUP_I2C1
	select EXYNOS4_SETUP_I2C3
	select EXYNOS4_SETUP_I2C4
	select EXYNOS4_SETUP_I2C5
	select EXYNOS4_SETUP_I2C6
	select EXYNOS4_SETUP_I2C7
	select EXYNOS4_SETUP_USB_PHY
	select EXYNOS4_SETUP_FIMD0
	select EXYNOS4_SETUP_MFC
	select EXYNOS4_SETUP_JPEG
	select S5P_DEV_FIMC0
	select S5P_DEV_FIMC1
	select S5P_DEV_FIMC2
	select S5P_DEV_FIMC3
	select S5P_DEV_CSIS0
	select S5P_DEV_CSIS1
	select S5P_DEV_FIMG2D
	select S3C64XX_DEV_SPI0
	select S3C64XX_DEV_SPI1
	select S3C64XX_DEV_SPI2
	select EXYNOS_SETUP_SPI
	select SAMSUNG_DEV_PWM
	select SAMSUNG_DEV_ADC
	select EXYNOS_PERSISTENT_CLOCK
	select EXYNOS_SOUND_PLATFORM_DATA
	help
	  Machine support for UNIVERASL222AP board

config MACH_CARMEN
	bool "CARMEN"
	select SOC_EXYNOS3470
	select S3C_DEV_I2C1
	select S3C_DEV_I2C3
	select S3C_DEV_I2C4
	select S3C_DEV_I2C5
	select S3C_DEV_I2C6
	select S3C_DEV_I2C7
	select S3C_DEV_WDT
	select S3C_DEV_RTC
	select S3C_DEV_USB_HSOTG
	select S5P_DEV_USB_EHCI
	select S5P_GPIO_INT
	select S5P_DEV_FIMD0
	select S5P_DEV_MFC
	select EXYNOS_DEV_DMA
	select EXYNOS_DEV_SYSMMU
	select EXYNOS_DEV_DWMCI
	select EXYNOS_SETUP_ADC
	select EXYNOS4_DEV_USB_OHCI
	select EXYNOS4_DEV_JPEG
	select EXYNOS4_SETUP_I2C1
	select EXYNOS4_SETUP_I2C3
	select EXYNOS4_SETUP_I2C4
	select EXYNOS4_SETUP_I2C5
	select EXYNOS4_SETUP_I2C6
	select EXYNOS4_SETUP_I2C7
	select EXYNOS4_SETUP_USB_PHY
	select EXYNOS4_SETUP_FIMD0
	select EXYNOS4_SETUP_MFC
	select EXYNOS4_SETUP_JPEG
	select S5P_DEV_FIMC0
	select S5P_DEV_FIMC1
	select S5P_DEV_FIMC2
	select S5P_DEV_FIMC3
	select S5P_DEV_CSIS0
	select S5P_DEV_CSIS1
	select S5P_DEV_FIMG2D
	select S3C64XX_DEV_SPI0
	select S3C64XX_DEV_SPI1
	select S3C64XX_DEV_SPI2
	select EXYNOS_SETUP_SPI
	select SAMSUNG_DEV_ADC
	select SAMSUNG_DEV_PWM
	select EXYNOS_PERSISTENT_CLOCK
	select EXYNOS_SOUND_PLATFORM_DATA
	help
	  Machine support for UNIVERASL222AP board

config MACH_KMINI
	bool "KMINI"
	select SOC_EXYNOS3470
	select S3C_DEV_I2C1
	select S3C_DEV_I2C3
	select S3C_DEV_I2C4
	select S3C_DEV_I2C5
	select S3C_DEV_I2C6
	select S3C_DEV_I2C7
	select S3C_DEV_WDT
	select S3C_DEV_RTC
	select S3C_DEV_USB_HSOTG
	select S5P_DEV_USB_EHCI
	select S5P_GPIO_INT
	select S5P_DEV_FIMD0
	select S5P_DEV_MFC
	select EXYNOS_DEV_DMA
	select EXYNOS_DEV_SYSMMU
	select EXYNOS_DEV_DWMCI
	select EXYNOS_SETUP_ADC
	select EXYNOS4_DEV_USB_OHCI
	select EXYNOS4_DEV_JPEG
	select EXYNOS4_SETUP_I2C1
	select EXYNOS4_SETUP_I2C3
	select EXYNOS4_SETUP_I2C4
	select EXYNOS4_SETUP_I2C5
	select EXYNOS4_SETUP_I2C6
	select EXYNOS4_SETUP_I2C7
	select EXYNOS4_SETUP_USB_PHY
	select EXYNOS4_SETUP_FIMD0
	select EXYNOS4_SETUP_MFC
	select EXYNOS4_SETUP_JPEG
	select S5P_DEV_FIMC0
	select S5P_DEV_FIMC1
	select S5P_DEV_FIMC2
	select S5P_DEV_FIMC3
	select S5P_DEV_CSIS0
	select S5P_DEV_CSIS1
	select S5P_DEV_FIMG2D
	select S3C64XX_DEV_SPI1
	select S3C64XX_DEV_SPI2
	select EXYNOS_SETUP_SPI
	select SAMSUNG_DEV_ADC
	select SAMSUNG_DEV_PWM
	select EXYNOS_PERSISTENT_CLOCK
	select EXYNOS_SOUND_PLATFORM_DATA
	help
	  Machine support for K-Mini board

config MACH_LT02
	bool "LT02"
	select SOC_EXYNOS3470
	select S3C_DEV_I2C1
	select S3C_DEV_I2C2
	select S3C_DEV_I2C3
	select S3C_DEV_I2C4
	select S3C_DEV_I2C5
	select S3C_DEV_I2C6
	select S3C_DEV_I2C7
	select S3C_DEV_WDT
	select S3C_DEV_RTC
	select S3C_DEV_USB_HSOTG
	select S5P_DEV_USB_EHCI
	select S5P_GPIO_INT
	select S5P_DEV_FIMD0
	select S5P_DEV_MFC
	select EXYNOS_DEV_DMA
	select EXYNOS_DEV_SYSMMU
	select EXYNOS_DEV_DWMCI
	select EXYNOS_SETUP_ADC
	select EXYNOS4_DEV_USB_OHCI
	select EXYNOS4_DEV_JPEG
	select EXYNOS4_SETUP_I2C1
	select EXYNOS4_SETUP_I2C2
	select EXYNOS4_SETUP_I2C3
	select EXYNOS4_SETUP_I2C4
	select EXYNOS4_SETUP_I2C5
	select EXYNOS4_SETUP_I2C6
	select EXYNOS4_SETUP_I2C7
	select EXYNOS4_SETUP_USB_PHY
	select EXYNOS4_SETUP_FIMD0
	select EXYNOS4_SETUP_MFC
	select EXYNOS4_SETUP_JPEG
	select S5P_DEV_FIMC0
	select S5P_DEV_FIMC1
	select S5P_DEV_FIMC2
	select S5P_DEV_FIMC3
	select S5P_DEV_CSIS0
	select S5P_DEV_CSIS1
	select S5P_DEV_FIMG2D
	select S5P_DEV_TV
	select S3C64XX_DEV_SPI0
	select S3C64XX_DEV_SPI1
	select S3C64XX_DEV_SPI2
	select EXYNOS_SETUP_SPI
	select SAMSUNG_DEV_ADC
	select EXYNOS_SOUND_PLATFORM_DATA
	help
	  Machine support for UNIVERASL222AP board

config EXYNOS_SOUND_PLATFORM_DATA
        bool "Sound platform data"
endmenu

source "arch/arm/mach-exynos/Kconfig.local"

endif

if ARCH_EXYNOS5

comment "EXYNOS5250 Boards"

config MACH_SMDK5250
	bool "SMDK5250"
	select SOC_EXYNOS5250
	select S3C_DEV_I2C1
	select S3C_DEV_I2C2
	select S3C_DEV_I2C4
	select S3C_DEV_I2C5
	select S3C_DEV_I2C7
	select S3C_DEV_RTC
	select S3C_DEV_WDT
	select S5P_DEV_MFC
	select S5P_DEV_DP
	select S5P_DEV_FIMD1
	select S5P_DEV_FIMG2D
	select S5P_DEV_TV
	select S5P_DEV_I2C_HDMIPHY
	select S5P_DEV_USB_EHCI
	select S5P_GPIO_INT
	select EXYNOS_DEV_DMA
	select EXYNOS_DEV_SYSMMU
	select EXYNOS_DEV_DWMCI
	select EXYNOS_DEV_SS_UDC
	select EXYNOS_DEV_DWC3
	select EXYNOS_SETUP_ADC
	select EXYNOS_SETUP_DP
	select EXYNOS_SETUP_FIMD1
	select EXYNOS_DEV_ROTATOR
	select EXYNOS_DEV_TMU
	select EXYNOS4_DEV_FIMC_IS
	select EXYNOS4_DEV_USB_OHCI
	select EXYNOS4_SETUP_I2C1
	select EXYNOS4_SETUP_I2C2
	select EXYNOS4_SETUP_I2C4
	select EXYNOS4_SETUP_I2C5
	select EXYNOS4_SETUP_I2C7
	select EXYNOS4_SETUP_MFC
	select EXYNOS4_SETUP_USB_PHY
	select EXYNOS4_SETUP_FIMC_IS
	select SAMSUNG_DEV_ADC
	select SAMSUNG_DEV_BACKLIGHT
	select SAMSUNG_DEV_PWM
	select S3C64XX_DEV_SPI0
	select S3C64XX_DEV_SPI1
	select S3C64XX_DEV_SPI2
	select EXYNOS_SETUP_SPI
	select EXYNOS5_DEV_BTS
	help
	  Machine support for Samsung SMDK5250
endif

comment "Flattened Device Tree based board for EXYNOS SoCs"

config MACH_EXYNOS4_DT
	bool "Samsung Exynos4 Machine using device tree"
	depends on ARCH_EXYNOS4
	select CPU_EXYNOS4210
	select USE_OF
	select ARM_AMBA
	select HAVE_SAMSUNG_KEYPAD if INPUT_KEYBOARD
	help
	  Machine support for Samsung Exynos4 machine with device tree enabled.
	  Select this if a fdt blob is available for the Exynos4 SoC based board.
	  Note: This is under development and not all peripherals can be supported
	  with this machine file.

config MACH_EXYNOS5_DT
	bool "SAMSUNG EXYNOS5 Machine using device tree"
	depends on ARCH_EXYNOS5
	select USE_OF
	select ARM_AMBA
	help
	  Machine support for Samsung Exynos4 machine with device tree enabled.
	  Select this if a fdt blob is available for the EXYNOS4 SoC based board.

config EXYNOS5_DEV_GSC
	bool
	depends on VIDEO_EXYNOS_GSCALER
	default y
	help
	  Compile in platform device definitions for GSC

config EXYNOS5_SETUP_GSC
	bool
	depends on VIDEO_EXYNOS_GSCALER
	default y
	help
	  Common setup code for GSC

config EXYNOS5_DEV_SCALER
	bool
	help
	  Compile in platform device definition for SCALER

config EXYNOS4_DEV_JPEG
	bool
	help
	  Compile in platform device definitions for JPEG

config EXYNOS4_SETUP_JPEG
	bool
	help
	  Common setup code for JPEG

config EXYNOS5_DEV_JPEG
	bool
	help
	  Compile in platform device definitions for JPEG

config EXYNOS5_SETUP_JPEG
	bool
	help
	  Common setup code for JPEG

config EXYNOS5_DEV_JPEG_HX
	bool
	help
	  Compile in platform device definitions for JPEG

config EXYNOS5_SETUP_JPEG_HX
	bool
	help
	  Common setup code for JPEG

config EXYNOS4_SETUP_CSIS
	bool
	depends on VIDEO_FIMC_MIPI
	default y
	help
	  Common setup code for MIPI-CSIS

config EXYNOS5_SETUP_TVOUT
	bool
	default y
	help
	  Common setup code for TVOUT

if ARCH_EXYNOS4

menu "MMC/SD slot setup"
depends on PLAT_S5P

comment "Configuration for HSMMC 8-bit bus width"

config EXYNOS4_SDHCI_CH0_8BIT
	bool "Channel 0 with 8-bit bus"
	help
	  Support HSMMC Channel 0 8-bit bus.
	  If selected, Channel 1 is disabled.

config EXYNOS4_SDHCI_CH2_8BIT
	bool "Channel 2 with 8-bit bus"
	help
	  Support HSMMC Channel 2 8-bit bus.
	  If selected, Channel 3 is disabled.
endmenu

endif

endmenu

endif

if ARCH_EXYNOS5
menu "SD/MMC/SDIO Support"
config EXYNOS_EMMC_HS200
	bool "eMMC HS200 Mode support"
	default n
	help
	 Enable HS200 mode foe eMMC device
endmenu
endif

comment "Debugging Feature"
menuconfig SEC_DEBUG
	bool "Samsung TN Ramdump Feature"
	default y
	help
	  Samsung TN Ramdump Feature. Use INFORM3 and magic number at 0xc0000000.

if SEC_DEBUG
config SEC_DEBUG_SCHED_LOG
	bool "Samsung Scheduler Logging Feature"
	default n
	help
	  Samsung Scheduler Logging Feature for Debug use.

config SEC_DEBUG_I2C_LOG
	bool "Samsung I2C Logging Feature"
	default y
	help
	  Samsung Scheduler Logging Feature for Debug use.

config SEC_DEBUG_PM_LOG
	bool "Samsung PM Logging Feature"
	default y
	help
	  Samsung PM Logging Feature for Debug use.

config SEC_DEBUG_SOFTIRQ_LOG
	bool "Samsung Softirq Logging Feature"
	default n
	depends on SEC_DEBUG_SCHED_LOG
	help
	  Samsung Softirq Logging Feature for Debug use.
	  This option enables us to log softirq enter/exit.
	  It is not only hard-irq which results in scheduler lockup,
	  To be more clear we need to see also softirq logs.

config SEC_DEBUG_SCHED_LOG_NONCACHED
	bool "Samsung Scheduler Logging on noncached buf"
	depends on SEC_DEBUG_SCHED_LOG
	default n
	help
	  This option enables sec_debug_sched_log_noncached support.
	  It can support non-cached sched log in RAM dump and We don't
	  need to concern cache flush status for analyzing sudden
	  lockup issue.

config SEC_DEBUG_SEMAPHORE_LOG
	bool "Samsung Semaphore Logging Feature"
	default n
	help
	  Samsung Semaphore Logging Feature for Debug use.

config SEC_DEBUG_USER
	bool "Panic on Userspace fault"
	default y
	help
	  Panic on Userspace fault

config SEC_DEBUG_AUXILIARY_LOG
	bool "Samsung Auxiliary Logging on noncached buf"
	default n
	help
	  This option enables sec_auxiliary_log support.
	  we can log repeated information insuitable for kernel log like DVFS
	  or power domain control information.
	  It can support non-cached auxiliary log in RAM dump and We don't
	  need to concern cache flush status for analyzing sudden
	  system hang issue.

config SEC_DEBUG_FUPLOAD_DUMP_MORE
	bool "Dump more information at forced upload"
	default n
	help
	  More information is printed out when a forced upload happens.
	  It uses customized dump functions instead of panic call.

menuconfig SEC_WATCHDOG_RESET
	bool "exynos5XXX watchdog reset to exit from lockup"
	depends on (SOC_EXYNOS5410 || SOC_EXYNOS5250 || SOC_EXYNOS3470)
	default n
	help
	  Use watchdog reset to exit from lockup

if SEC_WATCHDOG_RESET
config SEC_WATCHDOG_PET_TIME
	int "sec watchdog kicking time interval value"
	default 5
endif

endif

config ANDROID_WIP
	bool "work in progress hacks for android"
	default n
	help
	  This enables 'work in progress' hacks for android issues.

config ANDROID_OOM_KILLER
	bool "Android OOM Killer"
	default n
	help
	  This enables 'Android-Style oom-killer'
	  The way to select victim by oom-killer provided by
	  linux kernel is totally different from android policy.
	  Hence, it makes more sense that we select the oom victim
	  as android does when LMK is invoked.

config SEC_LOG
	default n
	bool "Enable support for sec_log" if EMBEDDED
	depends on PRINTK
	help
	  This option enables sec_log support. This provides combined
	  log buffer for both bootloader and kernel. It also preserves
	  previous content before reboot.

config SEC_LOG_NONCACHED
	default n
	bool "Enable non cached kernel sec_log support" if EMBEDDED
	depends on SEC_LOG
	help
	  This option enables sec_non_cached_klog support.  It can
	  support non-cached kernel log in RAM dump and We don't need
	  to concern cache flush status for analyzing sudden lockup
	  issue.

config SEC_LOG_LAST_KMSG
	default n
	bool "Enable /proc/last_kmsg support" if EMBEDDED
	depends on SEC_LOG
	help
	  This option enables /proc/last_kmsg support.

comment "Connectivity Feature"
config GPS_BCMxxxxx
	bool "BROADCOM_GPS_CHIPSET_COMMON"
	default n

config GPS_BCM4752
	bool "BROADCOM_GPS_CHIPSET_4752"
	default n

config GPS_CSRxT
	bool "CSR_GPS_CHIPSET_COMMON"
	default n

config GPS_GSD5T
	bool "CSR_GPS_CHIPSET_5T"
	default n

config BT_BCM4330
	bool "Enable BCM4330 driver"
	default n

config BT_BCM4334
	bool "Enable BCM4334 driver"
	default n
	help
	  Adds BCM4334 RFKILL driver for Broadcom BCM4334 chipset

config BT_BCM43241
	bool "Enable BCM43241 driver"
	default n
	help
	  Adds BCM43241 RFKILL driver for Broadcom BCM4334 chipset

config BT_BCM4335
	bool "Enable BCM4335 driver"
	default n
	help
	  Adds BCM4335 RFKILL driver for Broadcom BCM4335 chipset

config BT_BLUEDROID
	bool "Bluetooth bluedroid"
	default n

config USER_RESET_DEBUG
	bool "KOR ASTOOL debug feature"
	default n
	help
	  This option enables debugging log for B10 project.
	  This option provides reset history log in user version.
	  This option enable proc/reset_reason support
	  It's only support KOR Model

comment "PowerManagement Feature"
menuconfig SEC_PM
        bool "Samsung TN PowerManagement Feature"
        default y
        help 
          Samsung TN PowerManagement Feature.

if SEC_PM
config SEC_PM_DEBUG
        bool "Samsung TN PowerManagement Debug Feature"
        default n
        help 
          Samsung TN PowerManagement Debug Feature.

endif

config SEC_THERMISTOR
        bool "Use external thermistor with ADC" 
        depends on SAMSUNG_DEV_ADC
        default n
        help 
          AP thermistor driver.

config SEC_ONDEMAND_STEP
	bool "Enable CPU Ondemand Up Step"
	default n

#
# START of Samsung Mobile Modem Interface Configurations
#
comment "Modem Configuration Feature (SVNET2)"
config SEC_MODEM
	bool "Samsung Mobile Modem Interface (SVNET2)"
	default n

if SEC_MODEM

config SEC_MODEM_IF
	bool "Legacy AP-CP Interface"

config SEC_MODEM_V1
	bool "Memory-type AP-CP Interface"

config SEC_MODEM_V2
	bool "Serial-type AP-CP Interface"

choice
	prompt "Choose the modem configuration set for a certain PROJECT"
	default SEC_MODEM_UNIVERSAL222AP

config SEC_MODEM_SMDK4270
	bool "SMDK4270 with S.LSI SH222AP"
	select EXYNOS_DEV_MODEM_SS222
	select SEC_MODEM_V1
	select UMTS_MODEM_SH222AP
	select LINK_DEVICE_SHMEM

config SEC_MODEM_SMDK3470
	bool "SMDK3470 with S.LSI SH222AP"
	select EXYNOS_DEV_MODEM_SS222
	select SEC_MODEM_V1
	select UMTS_MODEM_SH222AP
	select LINK_DEVICE_SHMEM

config SEC_MODEM_UNIVERSAL222AP
	bool "UNIVERSAL222AP with S.LSI SH222AP"
	select EXYNOS_DEV_MODEM_SS222
	select SEC_MODEM_V1
	select UMTS_MODEM_SH222AP
	select LINK_DEVICE_SHMEM

config SEC_MODEM_GARDA
	bool "GARDA with S.LSI SH222AP"
	select EXYNOS_DEV_MODEM_SS222
	select SEC_MODEM_V1
	select UMTS_MODEM_SH222AP
	select LINK_DEVICE_SHMEM

config SEC_MODEM_CARMEN
	bool "CARMEN with S.LSI SH222AP"
	select EXYNOS_DEV_MODEM_SS222
	select SEC_MODEM_V1
	select UMTS_MODEM_SH222AP
	select LINK_DEVICE_SHMEM

config SEC_MODEM_WICHITA
	bool "WICHITA with S.LSI SH222AP"
	select EXYNOS_DEV_MODEM_SS222
	select SEC_MODEM_V1
	select UMTS_MODEM_SH222AP
	select LINK_DEVICE_SHMEM

config SEC_MODEM_KMINI
	bool "K-MINI with S.LSI SH222AP"
	select EXYNOS_DEV_MODEM_SS222
	select SEC_MODEM_V1
	select UMTS_MODEM_SH222AP
	select LINK_DEVICE_SHMEM

config SEC_MODEM_LT02
	bool "LT02 with S.LSI SH222AP"
	select EXYNOS_DEV_MODEM_SS222
	select SEC_MODEM_V1
	select UMTS_MODEM_SH222AP
	select LINK_DEVICE_SHMEM

endchoice

endif
#
# END of Samsung Mobile Modem Interface Configurations
#
```
