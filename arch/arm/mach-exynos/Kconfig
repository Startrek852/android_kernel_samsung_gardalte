## arch/arm/mach-exynos/Kconfig.local
```kconfig
choice
	prompt "Support Target Locale"
	default TARGET_LOCALE_USA

config TARGET_LOCALE_KOR
	bool "Locale Kor support"
	help
	  Enable universal222AP LOCALE KOR.
	  is used to distinguish LOCALE-related difference.

config TARGET_LOCALE_USA
	bool "Locale USA support"
	help
	  Enable universal222AP LOCALE USA.
	  is used to distinguish LOCALE-related difference.

config TARGET_LOCALE_EUR
	bool "Locale Europe Open support"
	help
	  Enable universal222AP LOCAL EUR.
	  is used to distinguish LOCALE-related difference.

endchoice

choice
	prompt "Support KOR Target Carrier"
	depends on MACH_GARDA && TARGET_LOCALE_KOR
	default MACH_DELOSLTE_KOR_SKT

config MACH_DELOSLTE_KOR_SKT
	bool "SKT Operator"
	help
	  Enable Carrier Operator SKT in LOCALE KOR.

config MACH_DELOSLTE_KOR_KT
	bool "KT Operator"
	help
	  Enable Carrier Operator KT in LOCALE KOR.

config MACH_DELOSLTE_KOR_LGT
	bool "LG U+ Operator"
	help
	  Enable Carrier Operator LGU in LOCALE KOR.

config MACH_DELOSLTE_KOR_ANY
	bool "ANY Operator"
	help
	  Enable Carrier Operator ANY in LOCALE KOR.
endchoice
```

## drivers/media/video/exynos/Kconfig
```kconfig
#
# Exynos multimedia device drivers
#
config VIDEO_EXYNOS
	bool "Exynos Multimedia Devices"
	depends on ARCH_EXYNOS4 || ARCH_EXYNOS5
	default n
	help
	  This is a representative exynos multimedia device.

if VIDEO_EXYNOS
	source "drivers/media/video/exynos/mdev/Kconfig"
	source "drivers/media/video/exynos/fimc-lite/Kconfig"
	source "drivers/media/video/exynos/mipi-csis/Kconfig"
	source "drivers/media/video/exynos/jpeg/Kconfig"
	source "drivers/media/video/exynos/jpeg_hx/Kconfig"
	source "drivers/media/video/exynos/fimg2d/Kconfig"
	source "drivers/media/video/exynos/mfc/Kconfig"
	source "drivers/media/video/exynos/tv/Kconfig"
	source "drivers/media/video/exynos/rotator/Kconfig"
	source "drivers/media/video/exynos/fimc-is/Kconfig"
endif

config MEDIA_EXYNOS
	bool
	help
	  Compile mdev to use exynos4/5 media device driver.
```

## drivers/media/video/exynos/fimc-is/Kconfig
```kconfig
config VIDEO_EXYNOS_FIMC_IS
	bool "Exynos FIMC-IS (Image Subsystem) driver"
	depends on VIDEO_EXYNOS
	select MEDIA_EXYNOS
	select SPI
	default n
	help
	  This is a v4l2 driver for exynos FIMC-IS device.
```

## drivers/misc/modem_v1/Kconfig
```kconfig
comment "Samsung Mobile Modem Interface (SVNET2) V1"
menuconfig SEC_MODEM_V1
	bool "Samsung Mobile Modem Interface (Memory-Type)"
	depends on SEC_MODEM
	default n
	---help---
	  Samsung Modem Interface Driver.

config CDMA_MODEM_CBP72
	bool "modem chip : VIA CBP7.2"
	depends on SEC_MODEM_V1
	default n

config LTE_MODEM_CMC221
	bool "modem chip : SEC CMC221"
	depends on SEC_MODEM_V1
	default n

config UMTS_MODEM_SS222
	bool "modem chip : SEC SS222"
	depends on SEC_MODEM_V1
	default n

config UMTS_MODEM_SH222AP
	bool "modem chip : SEC SH222AP (One-chip)"
	depends on SEC_MODEM_V1
	default n

config LINK_DEVICE_DPRAM
	bool "modem driver link device DPRAM"
	depends on SEC_MODEM_V1
	default n

config LINK_DEVICE_C2C
	bool "modem driver link device C2C"
	depends on SEC_MODEM_V1
	default n

config LINK_DEVICE_SHMEM
	bool "modem driver link device shared memory"
	depends on SEC_MODEM_V1
	default n
```

## drivers/sensor/Kconfig
```kconfig
#
# Sensor  drivers configuration
#
menuconfig SENSORS_CORE
	bool "Sensor devices"
	help
	  Say Y here, and a list of sensors drivers will be displayed.
	  Everything that didn't fit into the other categories is here. This option
	  doesn't affect the kernel.

	  If unsure, say Y.

if SENSORS_CORE

config SENSORS_BMA255
	tristate "BMA255 Accelelometer Sensor Driver"
	depends on I2C
	default n
	help
	  If you say yes here you get support for Bosch-Sensortec's
	  BMA255 Acceleration.

config SENSORS_AK09911C
	tristate "AK09911C compass support"
	default n
	depends on I2C
	help
	  If you say yes here you get support for Asahi Kasei's
	  orientation sensor AK8963.

config SENSORS_AK8963C
	tristate "AK8963 compass support"
	default n
	depends on I2C
	help
	  If you say yes here you get support for Asahi Kasei's
	  orientation sensor AK8963.

config SENSORS_AK8963C_FACTORY
	tristate "AK8963C factory test"
	default n
	depends on SENSORS_AK8963C
	help
	  If you say yes here you will support
	  factory test for AK8963C on the
	  device driver.
	  If you say no here you will support
	  it on the HAL layer.

config SENSORS_GP2A_PROXIMITY
	depends on I2C
	tristate "GP2A proximity driver"
	default n
	help
	  Say Y here if you use GP2A_PROXIMITY.
	  This option enables proximity sensors using
	  SHARP GP2A_ANALOG device driver.

	  Say N here if you do not use GP2A_ANALOG.

config SENSORS_K2DH
	tristate "K2DH acceleration sensor support"
	depends on I2C
        default n
	help
	  Say Y here if you use K2DH.
	  This option enables accelerometer sensors using
	  STM K2DH in K3DH device driver.

	  Say N here if you do not use K2DH.

config SENSORS_GP2A0X0
	depends on I2C
	tristate "GP2AP030A00F driver"
	default n
	help
	  This option enables proximity & light sensors using gp2ap030a00f driver.

config SENSORS_TMD27723
	depends on I2C
	tristate "TMD27723 driver"
	default n
	help
	  This option enables proximity & light sensors using TMD27723 driver.

config SENSORS_TMD26713
	depends on I2C
	tristate "TMD26713 driver"
	default n
	help
	   Say Y here if you use tmd26713
	   This option enables proximity sensors using
	   TAOS TMD26713 device driver

	   Say N here if you do not use tmd26713.

config SENSOR_USE_SYMLINK
	bool "sensors_symlink"
	depends on I2C

source "drivers/sensor/mpu6500/Kconfig"
source "drivers/sensor/alps/Kconfig"
endif
```
